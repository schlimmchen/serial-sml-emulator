#include <Arduino.h>
#include "smlCrcTable.h"

#define TX_PIN 22

HardwareSerial SmlSerial(1);

uint32_t constexpr intervalMs = 1000;
uint32_t previousMillis = 0;

const size_t smlBufferSize = 1024;
uint8_t smlBuffer[smlBufferSize];

uint8_t ctr = 0;

void setup() {
    Serial.begin(115200);
    SmlSerial.begin(9600, SERIAL_8N1, -1/*no RX*/, TX_PIN);
}

uint16_t crc16(uint16_t crc, unsigned char &byte)
{
    return pgm_read_word_near(&smlCrcTable[(byte ^ crc) & 0xff]) ^ (crc >> 8 & 0xff);
}

void loop() {
    unsigned long currentMillis = millis();

    if (currentMillis - previousMillis >= intervalMs) {
        previousMillis = currentMillis;

        // tibber pulse via tibber bridge known-good example SML datagram with 6 levels
        uint8_t tibber[] = {
            0x1b, 0x1b, 0x1b, 0x1b, 0x01, 0x01, 0x01, 0x01,
            0x76, 0x04, 0x00, 0x00, 0x01, 0x62, 0x00, 0x62, 0x00, 0x72, 0x65,
            0x00, 0x00, 0x01, 0x01, 0x76, 0x01, 0x01, 0x07, 0x00, 0x00, 0x00,
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            0x1a, 0x01, 0xa1, 0x37
        };

        uint8_t crafted[] = {
            0x1b, 0x1b, 0x1b, 0x1b, 0x01, 0x01, 0x01, 0x01, // start sequence
            // list start (0x70) with 7 items
            //    length of first item
            //          OBIS . . . . . . . . . . . . . . .
            //                                              filler?
            //                                                    filler?
            //                                                          unit . . .
            //                                                                      scaler . .
            //                                                                                  value . . . . .
            //                                                                                                    filler?
            0x77, 0x07, 0x01, 0x00, 0x10, 0x07, 0x00, 0xff, 0x01, 0x01, 0x62, 0x1b, 0x52, 0x00, 0x53, 0x01, 0xc6, 0x01, // total power
            0x77, 0x07, 0x01, 0x00, 0x20, 0x07, 0x00, 0xff, 0x01, 0x01, 0x62, 0x23, 0x52, 0xff, 0x63, 0x08, 0xf2, 0x01, // voltage L1
            0x77, 0x07, 0x01, 0x00, 0x34, 0x07, 0x00, 0xff, 0x01, 0x01, 0x62, 0x23, 0x52, 0xff, 0x63, 0x08, 0xde, 0x01, // voltage L2
            0x77, 0x07, 0x01, 0x00, 0x48, 0x07, 0x00, 0xff, 0x01, 0x01, 0x62, 0x23, 0x52, 0xff, 0x63, 0x08, 0xee, 0x01, // voltage L3
            0x77, 0x07, 0x01, 0x00, 0x1f, 0x07, 0x00, 0xff, 0x01, 0x01, 0x62, 0x21, 0x52, 0xfe, 0x62, 0x34, 0x01, // current L1
            0x77, 0x07, 0x01, 0x00, 0x33, 0x07, 0x00, 0xff, 0x01, 0x01, 0x62, 0x21, 0x52, 0xfe, 0x62, 0x23, 0x01, // current L2
            0x77, 0x07, 0x01, 0x00, 0x47, 0x07, 0x00, 0xff, 0x01, 0x01, 0x62, 0x21, 0x52, 0xfe, 0x62, 0xc7, 0x01, // current L3
            0x1b, 0x1b, 0x1b, 0x1b, // end sequence
            0x1a, 0x00, 0xde, 0xad, // 0x1a indicates checksum, 0x00 is filler, last two bytes are CRC16
        };

        uint16_t power = 400;
        power += ctr;

        crafted[23] = static_cast<uint8_t>((power >> 8) & 0xFF);
        crafted[24] = static_cast<uint8_t>(power & 0xFF);

        uint8_t* msg = crafted;
        size_t len = sizeof(crafted);

        uint16_t crc = 0xFFFF;
        for (int i = 0; i < len - 2; ++i) {
            crc = crc16(crc, msg[i]);
        }

        crc ^= 0xFFFF;

        msg[len-2] = static_cast<uint8_t>(crc);
        msg[len-1] = static_cast<uint8_t>(crc >> 8);

        // break the checksum in every tenth packet
        if (ctr % 10 == 0) {
            msg[len-2] = 0xde;
            msg[len-1] = 0xad;
        }

        // mess with the decoder (pretend that a list containing 15 elements follows)
        if (ctr % 10 == 2) {
            msg[26] = 0x7F;
        }

        SmlSerial.write(msg, len);
        Serial.printf("%d: sent total power = %d W (total %d Bytes)\r\n", millis(), power, len);

        ctr = (ctr + 1) % 100;
    }
}
